## drivers/misc/mediatek/sensors-1.0/magnetometer/mmc3524x/Kconfig
```kconfig
config MTK_MMC3524X
	tristate "MMC3524X for MediaTek package"
	default n
	help
	  It support different magnetometer sensor.
	  If this option is set, it will support
	  MMC3524X magnetometer which is a 3-axis electronic
	  compass IC with high sensitive Hall sensor technology.
```
